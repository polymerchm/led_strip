## main/Kconfig.projbuild
```kconfig
menu "LED Strip"
    config SPARKLE_NUM_PIXELS
        int
        prompt "Num Pixels"
        default 20

    config  SPARKLE_PULSE_DURATION_FRAMES
        int
        prompt "Total Pulse Dration (frames)"
        default 21
        help
          Enter an odd number

    config  SPARKLE_TIME_FRAMES
        int
        prompt "Number of Time Slices"
        default 1000

    config SPARKLE_TIME_PER_FRAME
        int
        prompt "Time in ms per frame"
        default 20


    config  SPARKLE_RMT_LED_STRIP_GPIO_NUM
        int
        prompt "RMT GIO PIN"
        default 13 

    config  SPARKLE_RMT_LED_STRIP_RESOLUTION_HZ
        int
        prompt "RMT RESOLUTION"
        default 10000000

endmenu
    
```
